## conf/layer.conf
```bitbake
# We have a conf and classes directory, add to BBPATH
BBPATH .= ":${LAYERDIR}"

# We have recipes-* directories, add to BBFILES
BBFILES += "${LAYERDIR}/recipes-*/*/*.bb \
            ${LAYERDIR}/recipes-*/*/*.bbappend"

BBFILE_COLLECTIONS += "medusa-backport"
BBFILE_PATTERN_medusa-backport = "^${LAYERDIR}/"
BBFILE_PRIORITY_medusa-backport = "10"

LAYERSERIES_COMPAT_medusa-backport = "sumo"
```
